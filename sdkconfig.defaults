## sdkconfig.defaults
```kconfig
CONFIG_BOOTLOADER_FLASH_DC_AWARE=y

CONFIG_ESP_DEFAULT_CPU_FREQ_MHZ_240=y
CONFIG_ESPTOOLPY_FLASHMODE_DOUT=y
CONFIG_ESPTOOLPY_FLASHFREQ_120M=y
CONFIG_SPIRAM_SPEED_120M=y

CONFIG_TINYUSB_CDC_ENABLED=y

CONFIG_SPIRAM=y
CONFIG_SPIRAM_BOOT_INIT=y
CONFIG_SPIRAM_MODE_QUAD=y
CONFIG_SPIRAM_TYPE_AUTO=y
CONFIG_SPIRAM_ALLOW_STACK_EXTERNAL_MEMORY=y
CONFIG_SPIRAM_USE_CAPS_ALLOC=y
CONFIG_SPIRAM_MEMTEST=n

CONFIG_COMPILER_OPTIMIZATION_PERF=y
CONFIG_DSP_OPTIMIZED=y
CONFIG_DSP_MAX_FFT_SIZE=4096

# tiny-usb latency should be < 1ms; 1000 is max
CONFIG_FREERTOS_HZ=1000
```
